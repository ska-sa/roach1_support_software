## denx_mainline_linux/drivers/i2c/chips/Kconfig
```kconfig
#
# Miscellaneous I2C chip drivers configuration
#
# *** DEPRECATED! Do not add new entries! See Makefile ***
#

menu "Miscellaneous I2C Chip support"

config SENSORS_24C01A
	tristate "24C01A EEPROM driver"
	depends on I2C && EXPERIMENTAL
	default n
	help
	  If you say yes here you get support for the 24C01A EEPROM driver.

	  This driver can also be built as a module.  If so, the module
	  will be called 24c01a.

config SENSORS_AD7416
	tristate "AD7416 temperature sensor"
	depends on I2C && EXPERIMENTAL
	default n
	help
	  If you say yes here you get support for the AD7416 temperature sensor.

	  This driver can also be built as a module.  If so, the module
	  will be called ad7416.

config DS1682
	tristate "Dallas DS1682 Total Elapsed Time Recorder with Alarm"
	depends on EXPERIMENTAL
	help
	  If you say yes here you get support for Dallas Semiconductor
	  DS1682 Total Elapsed Time Recorder.

	  This driver can also be built as a module.  If so, the module
	  will be called ds1682.

config SENSORS_TSL2550
	tristate "Taos TSL2550 ambient light sensor"
	depends on EXPERIMENTAL
	help
	  If you say yes here you get support for the Taos TSL2550
	  ambient light sensor.

	  This driver can also be built as a module.  If so, the module
	  will be called tsl2550.

endmenu
```
